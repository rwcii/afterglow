## sdkconfig.defaults
```kconfig
# Afterglow default sdkconfig — XIAO ESP32-S3
# These are committed defaults; the generated `sdkconfig` is gitignored.

CONFIG_IDF_TARGET="esp32s3"

# --- PSRAM (8 MB on XIAO ESP32-S3) — required for the beacon pool slab ---
CONFIG_ESP32S3_SPIRAM_SUPPORT=y
CONFIG_SPIRAM=y
CONFIG_SPIRAM_MODE_OCT=y
CONFIG_SPIRAM_SPEED_80M=y
# Do NOT auto-route malloc to PSRAM: capture path must copy to internal RAM first
# (DMA/ISR cannot touch PSRAM). The pool allocates PSRAM explicitly via
# heap_caps_malloc(MALLOC_CAP_SPIRAM).
CONFIG_SPIRAM_USE_MALLOC=n

# --- Coexistence: Wi-Fi + BLE share one radio ---
CONFIG_ESP_COEX_SW_COEXIST_ENABLE=y

# --- Wi-Fi: promiscuous capture + raw 802.11 TX ---
CONFIG_ESP_WIFI_ENABLED=y

# --- Bluetooth: Bluedroid (preferred over NimBLE for runtime TX-power control) ---
CONFIG_BT_ENABLED=y
CONFIG_BT_BLUEDROID_ENABLED=y
CONFIG_BT_NIMBLE_ENABLED=n
# (esp32s3 controller is BLE-only by default — no dual-mode setting needed.)
# Legacy (BLE 4.2) advertising + scan APIs — Afterglow uses legacy advertising
# only (esp_ble_gap_start_advertising / set_scan_params / config_adv_data_raw).
CONFIG_BT_BLE_42_FEATURES_SUPPORTED=y
CONFIG_BT_BLE_50_FEATURES_SUPPORTED=n

# --- Flash (8 MB) ---
CONFIG_ESPTOOLPY_FLASHSIZE_8MB=y
CONFIG_PARTITION_TABLE_SINGLE_APP_LARGE=y

# --- Console: route to USB-Serial-JTAG. The XIAO ESP32-S3 exposes only its
# native USB (USB-Serial-JTAG); UART0 is not wired to the USB connector, so the
# default UART console would be invisible over USB. ---
CONFIG_ESP_CONSOLE_USB_SERIAL_JTAG=y
# CONFIG_ESP_CONSOLE_UART_DEFAULT is not set

# --- Logging ---
CONFIG_LOG_DEFAULT_LEVEL_INFO=y
```

## test/target/sdkconfig.defaults
```kconfig
# Target-test defaults — mirror the firmware's radio/PSRAM options so the test
# app (which links radio_single -> esp_bt.h) configures the same way as the
# main build. Kept in sync with the top-level sdkconfig.defaults.

CONFIG_IDF_TARGET="esp32s3"

# PSRAM — the pool slab allocates from SPIRAM via heap_caps_malloc.
CONFIG_ESP32S3_SPIRAM_SUPPORT=y
CONFIG_SPIRAM=y
CONFIG_SPIRAM_MODE_OCT=y
CONFIG_SPIRAM_SPEED_80M=y
CONFIG_SPIRAM_USE_MALLOC=n

# Wi-Fi + BLE coexistence.
CONFIG_ESP_COEX_SW_COEXIST_ENABLE=y
CONFIG_ESP_WIFI_ENABLED=y

# Bluetooth: Bluedroid with BLE 4.2 legacy advertising (radio_single uses the
# legacy esp_ble_gap_* APIs and includes esp_bt.h).
CONFIG_BT_ENABLED=y
CONFIG_BT_BLUEDROID_ENABLED=y
CONFIG_BT_NIMBLE_ENABLED=n
CONFIG_BT_BLE_42_FEATURES_SUPPORTED=y
CONFIG_BT_BLE_50_FEATURES_SUPPORTED=n

# Flash (8 MB) + a large single-app partition: the test app links BT + Wi-Fi +
# Unity and exceeds the default 1 MB factory partition.
CONFIG_ESPTOOLPY_FLASHSIZE_8MB=y
CONFIG_PARTITION_TABLE_SINGLE_APP_LARGE=y
```

## tools/adv-observer/sdkconfig.defaults
```kconfig
CONFIG_IDF_TARGET="esp32s3"
CONFIG_BT_ENABLED=y
CONFIG_BT_BLUEDROID_ENABLED=y
CONFIG_BT_BLE_ENABLED=y
CONFIG_BT_BLE_42_FEATURES_SUPPORTED=y
CONFIG_BT_BLE_50_FEATURES_SUPPORTED=n
CONFIG_BT_CONTROLLER_ENABLED=y
CONFIG_BT_GATTS_ENABLE=n
CONFIG_BT_GATTC_ENABLE=n
```
